## mt7915/Kconfig
```kconfig
# SPDX-License-Identifier: BSD-3-Clause-Clear
config MT7915E
	tristate "MediaTek MT7915E (PCIe) support"
	select MT76_CONNAC_LIB
	select WANT_DEV_COREDUMP
	depends on MAC80211
	depends on PCI
	select RELAY
	help
	  This adds support for MT7915-based PCIe wireless devices,
	  which support concurrent dual-band operation at both 5GHz
	  and 2.4GHz IEEE 802.11ax 4x4:4SS 1024-QAM, 160MHz channels,
	  OFDMA, spatial reuse and dual carrier modulation.

	  To compile this driver as a module, choose M here.

config MT798X_WMAC
	bool "MT798x (SoC) WMAC support"
	depends on MT7915E
	depends on ARCH_MEDIATEK || COMPILE_TEST
	select REGMAP
	help
	  This adds support for the built-in WMAC on MT7981 and MT7986 SoC device
	  which has the same feature set as a MT7915, but enables 6E
	  support.

config MT7915_NPU
	bool "MT7915 ClankerNPU receive support on EN7523"
	depends on MT7915E
	depends on NET_AIROHA_NPU=y || MT7915E=NET_AIROHA_NPU
	help
	  Enable the ClankerNPU 24-byte receive transport on EN7523. This needs
	  a single PCIe MT7915 DBDC radio, matching firmware,
	  an explicit device-tree configuration and npu_enable=1.
	  Receive reordering remains on the host. A DT opt-in allows WED TX
	  alongside NPU RX. If unsure, say N.
```
